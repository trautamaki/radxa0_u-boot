## board/amlogic/g12a_radxa0_v1/Kconfig
```kconfig
if TARGET_G12A_RADXA0_V1

config SYS_CPU
	string
	default "armv8"

config SYS_BOARD
	string
	default "g12a_radxa0_v1"

config SYS_VENDOR
	string
	default "amlogic"

config SYS_SOC
	string
	default "g12a"

config SYS_CONFIG_NAME
	default "g12a_radxa0_v1"

endif
```
